## firmware/spotlight/components/button_handler/Kconfig
```kconfig
menu "Spotlight Button Handler Configuration"

    config SPOTLIGHT_BUTTON_GPIO
        int "Button Input GPIO Pin"
        default 9 
        range 0 48
        help
            GPIO pin connected to the physical button (BOOT button is usually GPIO 8 or GPIO 0).

    config SPOTLIGHT_BUTTON_LONG_PRESS_MS
        int "Long Press Provisioning Hold Time (ms)"
        default 5000
        range 2000 15000
        help
            Continuous hold time in milliseconds required to trigger SoftAP provisioning mode.

endmenu
```

## firmware/spotlight/components/led_driver/Kconfig
```kconfig
menu "Spotlight LED Driver Configuration"

    config SPOTLIGHT_LED_GPIO
        int "LED Output GPIO Pin"
        default 10
        range 0 48
        help
            GPIO pin connected to the Spotlight LED. Default is GPIO 10.

    config SPOTLIGHT_PWM_FREQ_HZ
        int "LEDC PWM Frequency (Hz)"
        default 32000
        range 100 100000
        help
            Frequency of the PWM output signal in Hz. Default is 32000 Hz (32 kHz).

    config SPOTLIGHT_LEDC_TIMER
        int "LEDC Timer Index"
        default 0
        range 0 3
        help
            LEDC hardware timer to use (0 to 3).

    config SPOTLIGHT_QUEUE_SIZE
        int "FreeRTOS LED Queue Capacity"
        default 10
        range 1 50
        help
            Number of command messages the LED Queue can store before blocking.

    config SPOTLIGHT_TASK_STACK_SIZE
        int "LED Task Stack Size (bytes)"
        default 4096
        range 2048 16384
        help
            Stack size allocated to the led_task in bytes.

endmenu
```

## firmware/spotlight/components/mqtt_handler/Kconfig
```kconfig
menu "MQTT Handler Configuration"

    config SPOTLIGHT_MQTT_TEST_TOPIC
        string "MQTT Test Topic"
        default "test/topic"
        help
            The default topic to subscribe to for testing the Reaction Engine.

endmenu
```

## firmware/spotlight/components/wifi-handler/Kconfig
```kconfig
menu "Spotlight Wi-Fi & Provisioning Configuration"

    config SPOTLIGHT_AP_SSID
        string "SoftAP Network Name (SSID)"
        default "Spotlight-Setup"
        help
            SSID network name broadcast by the ESP32 during SoftAP provisioning mode.

    config SPOTLIGHT_AP_CHANNEL
        int "SoftAP Wi-Fi Channel"
        default 1
        range 1 13
        help
            Wi-Fi channel (1 to 13) for the SoftAP.

endmenu
```
